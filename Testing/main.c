// Hand PIC'd 32
// By: Professor Steven Chad Burrow


/*
VESA Signal 1280 x 1024 @ 60 Hz timing

Interested in easy to use VGA solution for embedded applications? Click here!

General timing
Screen refresh rate	60 Hz
Vertical refresh	63.981042654028 kHz
Pixel freq.	108.0 MHz
Horizontal timing (line)
Polarity of horizontal sync pulse is positive.

Scanline part	Pixels	Time [µs]
Visible area	1280	11.851851851852
Front porch	48	0.44444444444444
Sync pulse	112	1.037037037037
Back porch	248	2.2962962962963
Whole line	1688	15.62962962963
Vertical timing (frame)
Polarity of vertical sync pulse is positive.

Frame part	Lines	Time [ms]
Visible area	1024	16.004740740741
Front porch	1	0.01562962962963
Sync pulse	3	0.046888888888889
Back porch	38	0.59392592592593
Whole frame	1066	16.661185185185
*/

/*	
Interrupt from Visible Timer at beginning of scanline, DMA0 to start.
DMA0 transfers single byte to DMA1 config to enable it.
DMA1 transfers ~400 pixels to PMP on Pixel Timer.
DMA1 chains to DMA2 which transfers a zero to PMP or PORTx.
All of this is independent of sync signals and timers!
Increment line number and change addresses on separate interrupt!
*/ 

/*
// Video Color Signals
PORTH

// Video Clock Signals
Pin104,RD0,PIXEL-CLOCK
Pin119,RD5,VISIBLE-CLOCK
Pin110,RD2,H-SYNC
Pin111,RD3,V-SYNC

// Audio
PORTJ

// SDcard
Pin120,RD6,MISO
Pin121,RD7,MOSI
Pin109,RD1,SCK1
Pin118,RD4,CS

// PS/2 Keyboard/Mouse
Pin98,RD10,KEY-CLK
Pin99,RD11,KEY-DAT
Pin112,RD12,MOUSE-CLK
Pin113,RD13,MOUSE-DAT

// Joysticks
Pin19,RK0,JOY-A-UP
Pin51,RK1,JOY-A-DOWN
Pin52,RK2,JOY-A-LEFT
Pin53,RK3,JOY-A-RIGHT
Pin92,RK4,JOY-A-BUTTON1
Pin93,RK5,JOY-A-BUTTON2
Pin124,RF0,JOY-B-UP
Pin125,RF1,JOY-B-DOWN
Pin79,RF2,JOY-B-LEFT
Pin90,RF4,JOY-B-RIGHT
Pin91,RF5,JOY-B-BUTTON1
Pin80,RF8,JOY-B-BUTTON2
Pin94,RK6,JOY-SELECT

// Programmer
Pin20,MCLR
Pin36,RB0,PGED1
Pin35,RB1,PGEC1

// USB
Pin78,USBID
Pin77,D+
Pin76,D-

// Oscillator
Pin71,RC12,OSC1/CLKI
Pin72,RC15,OSC2/CLKO

// UART
Pin69,RD14,U3TX
Pin70,RD15,U3RX

// LED
Pin97,RD9,LED

// Button
Pin126,RK7,EXT-BUTTON
*/


// By the way, to convert .mp4 to .gif:
// ffmpeg -i input.mp4 -vf scale=320:-1 -r 10 -f image2pipe -vcodec ppm - | convert -delay 10 -loop 0 - output.gif


// When connecting with the UART, use:
// sudo picocom /dev/ttyUSB0


// PIC32MZ2048EFM144 Configuration Bit Settings

// 'C' source line config statements

// DEVCFG3
#pragma config USERID = 0xFFFF          // Enter Hexadecimal value (Enter Hexadecimal value)
#pragma config FMIIEN = ON              // Ethernet RMII/MII Enable (MII Enabled)
#pragma config FETHIO = OFF             // Ethernet I/O Pin Select (Alternate Ethernet I/O)
#pragma config PGL1WAY = OFF            // Permission Group Lock One Way Configuration (Allow multiple reconfigurations)
#pragma config PMDL1WAY = OFF           // Peripheral Module Disable Configuration (Allow multiple reconfigurations)
#pragma config IOL1WAY = OFF            // Peripheral Pin Select Configuration (Allow multiple reconfigurations)
#pragma config FUSBIDIO = OFF           // USB USBID Selection (Controlled by Port Function)

// DEVCFG2
#pragma config FPLLIDIV = DIV_3         // System PLL Input Divider (3x Divider)
#pragma config FPLLRNG = RANGE_5_10_MHZ// System PLL Input Range (5-10 MHz Input)
#pragma config FPLLICLK = PLL_POSC       // System PLL Input Clock Selection (FRC is input to the System PLL)
#pragma config FPLLMULT = MUL_50       // System PLL Multiplier (PLL Multiply by 50)
#pragma config FPLLODIV = DIV_2         // System PLL Output Clock Divider (2x Divider)
#pragma config UPLLFSEL = FREQ_24MHZ    // USB PLL Input Frequency Selection (USB PLL input is 24 MHz)

// DEVCFG1
#pragma config FNOSC = FRCDIV           // Oscillator Selection Bits (Fast RC Osc w/Div-by-N (FRCDIV))
#pragma config DMTINTV = WIN_127_128    // DMT Count Window Interval (Window/Interval value is 127/128 counter value)
#pragma config FSOSCEN = OFF            // Secondary Oscillator Enable (Disable SOSC)
#pragma config IESO = ON                // Internal/External Switch Over (Enabled)
#pragma config POSCMOD = HS             // Primary Oscillator Configuration (HS osc mode)
#pragma config OSCIOFNC = ON            // CLKO Output Signal Active on the OSCO Pin (Enabled)
#pragma config FCKSM = CSECME           // Clock Switching and Monitor Selection (Clock Switch Enabled, FSCM Enabled)
#pragma config WDTPS = PS1048576        // Watchdog Timer Postscaler (1:1048576)
#pragma config WDTSPGM = STOP           // Watchdog Timer Stop During Flash Programming (WDT stops during Flash programming)
#pragma config WINDIS = NORMAL          // Watchdog Timer Window Mode (Watchdog Timer is in non-Window mode)
#pragma config FWDTEN = OFF             // Watchdog Timer Enable (WDT Disabled)
#pragma config FWDTWINSZ = WINSZ_50     // Watchdog Timer Window Size (Window size is 50%)
#pragma config DMTCNT = DMT31           // Deadman Timer Count Selection (2^31 (2147483648))
#pragma config FDMTEN = OFF             // Deadman Timer Enable (Deadman Timer is disabled)

// DEVCFG0
#pragma config DEBUG = OFF              // Background Debugger Enable (Debugger is disabled)
#pragma config JTAGEN = OFF             // JTAG Enable (JTAG Disabled)
#pragma config ICESEL = ICS_PGx1        // ICE/ICD Comm Channel Select (Communicate on PGEC1/PGED1)
#pragma config TRCEN = OFF               // Trace Disable (Trace features in the CPU are disabled)
#pragma config BOOTISA = MIPS32         // Boot ISA Selection (Boot code and Exception code is MIPS32)
//#pragma config FECCCON = OFF_UNLOCKED   // Dynamic Flash ECC Configuration (ECC and Dynamic ECC are disabled (ECCCON bits are writable))
#pragma config FECCCON = ON             // Dynamic Flash ECC Configuration (Flash ECC is enabled (ECCCON bits are locked))
#pragma config FSLEEP = VREGS           // Flash Sleep Mode (Flash power down is controlled by the VREGS bit)
#pragma config DBGPER = PG_ALL          // Debug Mode CPU Access Permission (Allow CPU access to all permission regions)
#pragma config SMCLR = MCLR_NORM        // Soft Master Clear Enable bit (MCLR pin generates a normal system Reset)
#pragma config SOSCGAIN = GAIN_2X       // Secondary Oscillator Gain Control bits (2x gain setting)
#pragma config SOSCBOOST = OFF          // Secondary Oscillator Boost Kick Start Enable bit (Normal start of the oscillator)
#pragma config POSCGAIN = GAIN_2X       // Primary Oscillator Gain Control bits (2x gain setting)
#pragma config POSCBOOST = OFF          // Primary Oscillator Boost Kick Start Enable bit (Normal start of the oscillator)
#pragma config EJTAGBEN = NORMAL        // EJTAG Boot (Normal EJTAG functionality)

// DEVCP0
#pragma config CP = OFF                 // Code Protect (Protection Disabled)

// SEQ3
#pragma config TSEQ = 0xFFFF            // Boot Flash True Sequence Number (Enter Hexadecimal value)
#pragma config CSEQ = 0xFFFF            // Boot Flash Complement Sequence Number (Enter Hexadecimal value)

// #pragma config statements should precede project file includes.
// Use project enums instead of #define for ON and OFF.

#include <xc.h>

// keeps program code from being written here, reserved for NES
#pragma region name="game_rom" origin=0x9D100000 size=0x00100000

#define SYS_FREQ 200000000 // Running at 200MHz



unsigned long VirtToPhys(volatile void* p) // changed 'const' to 'volatile'
{
	return (long)p<0?((long)p&0x1fffffffL):(unsigned long)((unsigned long*)p+0x40000000L);
}

void DelayMS(unsigned int s)
{
	unsigned long count = 0x00000000;
	
	count = (unsigned long)((unsigned long)((SYS_FREQ / 1000) * s) / 2); // Convert microseconds us into how many clock ticks it will take
       
	_CP0_SET_COUNT(0); // Set Core Timer count to 0
    
	while (count > _CP0_GET_COUNT()); // Wait until Core Timer count reaches the number we calculated earlier
}

// if using UART, use command 'sudo picocom /dev/ttyUSB0' in Linux
void SendChar(char value)
{
	char temp = value;
	while (U3STAbits.UTXBF == 1) { }
	U3TXREG = (char)(temp);
}

void SendString(char *value)
{
	char temp;
	for (unsigned int i=0; i<256; i++)
	{
		temp = value[i];
		
		if (temp == '\\') break;
		else
		{
			while (U3STAbits.UTXBF == 1) { }
			U3TXREG = (char)(temp);
		}
	}
}

void SendHex(unsigned char value)
{
	unsigned char temp = value;
	while (U3STAbits.UTXBF == 1) { }
	if (temp/16 >= 10) U3TXREG = (char)(temp/16 + 'A' - 10);
	else U3TXREG = (char)(temp/16 + '0');
	while (U3STAbits.UTXBF == 1) { }
	if (temp%16 >= 10) U3TXREG = (char)(temp%16 + 'A' - 10);
	else U3TXREG = (char)(temp%16 + '0');
}

void SendLongHex(unsigned long value)
{
	unsigned long temp = value;
	SendHex((unsigned char)(temp >> 24));
	SendHex((unsigned char)(temp >> 16));
	SendHex((unsigned char)(temp >> 8));
	SendHex((unsigned char)(temp));
}

void _general_exception_handler(void)
{
	SendString("General Exception\n\r\\");
	SendLongHex(((_CP0_GET_CAUSE() & 0x0000007C) >> 2));
	SendString("\n\r\\");
    SendLongHex(_CP0_GET_EPC());
	SendString("\n\r\\");
	
	DelayMS(1000);
	
	// soft reset system
	SYSKEY = 0x0; // reset
	SYSKEY = 0xAA996655; // unlock key #1
	SYSKEY = 0x556699AA; // unlock key #2
	RSWRST = 1; // set bit to reset of system
	SYSKEY = 0x0; // re-lock
	RSWRST; // read from register to reset
	while (1) { } // wait until reset occurs
}


#define SCREEN_X 512
#define SCREEN_X2 1024
#define SCREEN_Y 240
#define SCREEN_XY 122880
#define SCREEN_XY2 245760

// video
volatile unsigned char __attribute__((coherent,address(0x8004F800))) screen_line[SCREEN_X2];
volatile unsigned char __attribute__((coherent,address(0x80010000))) screen_buffer[SCREEN_XY2]; // visible portion of screen
volatile unsigned char screen_frame = 0;
volatile unsigned int screen_scanline = 1025; // start of vertical sync
volatile unsigned char __attribute__((coherent)) screen_zero[2] = { 0x00, 0x00 }; // zero value for black

#define AUDIO_LEN 256

// audio
volatile unsigned char __attribute__((coherent,address(0x8004D000))) audio_buffer[AUDIO_LEN];
volatile unsigned int audio_read = 0;
volatile unsigned int audio_write = 0;
volatile unsigned int audio_enable = 0;

// controllers
volatile unsigned char controller_status_1 = 0x00;
volatile unsigned char controller_status_2 = 0x00;
volatile unsigned char controller_status_3 = 0x00;
volatile unsigned char controller_status_4 = 0x00;
volatile unsigned char controller_enable = 0;


const unsigned char text_bitmap[64*96] = { 
	0x00,0x00,0x00,0x00,0x00,0x00,0x00,0x00,0x00,0x00,0x00,0x00,0x00,0x00,0x00,0x00,0x00,0x00,0x00,0x00,0x00,0x00,0x00,0x00,0x00,0x00,0x00,0x00,0x00,0x00,0x00,0x00, // 32
	0x00,0x00,0x00,0x00,0x00,0x00,0x00,0x00,0x00,0x00,0x00,0x00,0x00,0x00,0x00,0x00,0x00,0x00,0x00,0x00,0x00,0x00,0x00,0x00,0x00,0x00,0x00,0x00,0x00,0x00,0x00,0x00,
	0x00,0x00,0xFF,0xFF,0x00,0x00,0x00,0x00,0x00,0xFF,0xFF,0xFF,0xFF,0x00,0x00,0x00,0x00,0xFF,0xFF,0xFF,0xFF,0x00,0x00,0x00,0x00,0xFF,0xFF,0xFF,0xFF,0x00,0x00,0x00,
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	0x00,0x00,0x00,0x00,0x00,0x00,0x00,0x00,0x00,0x00,0x00,0x00,0x00,0x00,0x00,0x00,0x00,0x00,0x00,0x00,0x00,0x00,0x00,0x00,0x00,0x00,0x00,0x00,0x00,0x00,0x00,0x00,
};

unsigned char display_foreground_color = 0xFF;
unsigned char display_background_color = 0x00;

void display_character(unsigned int x, unsigned int y, unsigned char value)
{
	unsigned int pos = (unsigned int)(value - 32) * 64;
  
	for (unsigned int i=0; i<8; i++)
	{		
		for (unsigned int j=0; j<8; j++)
		{
			if (text_bitmap[pos+i*8+j] == 0x00)
			{
				screen_buffer[(y+i)*SCREEN_X+(x+j)] = display_background_color;
			}
			else
			{
				screen_buffer[(y+i)*SCREEN_X+(x+j)] = display_foreground_color;
			}
		}
	}
};

void display_inverse(unsigned int x, unsigned int y, unsigned char value)
{
	unsigned int pos = (unsigned int)(value - 32) * 64;
  
	for (unsigned int i=0; i<8; i++)
	{		
		for (unsigned int j=0; j<8; j++)
		{
			if (text_bitmap[pos+i*8+j] == 0x00)
			{
				screen_buffer[(y+i)*SCREEN_X+(x+j)] = display_foreground_color;
			}
			else
			{
				screen_buffer[(y+i)*SCREEN_X+(x+j)] = display_background_color;
			}
		}
	}
};
	
void display_decimal(unsigned int x, unsigned int y, unsigned int value)
{
	volatile unsigned int temp = 0;
	volatile unsigned int next = 0;
	
	next = value;
	
	temp = next / 10000;
	display_character(x, y, (unsigned char)(temp + '0'));
	next = next - 10000 * temp;
	
	temp = next / 1000;
	display_character(x + 0x08, y, (unsigned char)(temp + '0'));
	next = next - 1000 * temp;
	
	temp = next / 100;
	display_character(x + 0x10, y, (unsigned char)(temp + '0'));
	next = next - 100 * temp;
	
	temp = next / 10;
	display_character(x + 0x18, y, (unsigned char)(temp + '0'));
	next = next - 10 * temp;
	
	temp = next;
	display_character(x + 0x20, y, (unsigned char)(temp + '0'));
};

void display_string(unsigned int x, unsigned int y, char *value)
{
	volatile unsigned char pos = 0;
	
	while (value[pos] != '\\')
	{
		display_character(x + pos * 8, y, value[pos]);
		
		pos++;
	}
};




// PS/2 keyboard variables
volatile char __attribute__((coherent)) ps2_state_array[2][256];
volatile unsigned int __attribute__((coherent)) ps2_cursor_x[2][256];
volatile unsigned int __attribute__((coherent)) ps2_cursor_y[2][256];
volatile unsigned char __attribute__((coherent)) ps2_mode[2] = { 0x00, 0x00 };
volatile unsigned char __attribute__((coherent)) ps2_writepos[2] = { 0x00, 0x00 };
volatile unsigned char __attribute__((coherent)) ps2_readpos[2] = { 0x00, 0x00 };

volatile unsigned char ps2_counter[2] = { 0x00, 0x00 };
volatile unsigned char ps2_buffer[2] = { 0x00, 0x00 };
volatile unsigned char ps2_sequence[2] = { 0xFF, 0xFF }; // starts with 0xFA acknowledge byte
volatile unsigned char ps2_shift[2] = { 0x00, 0x00 };
volatile unsigned char ps2_release[2] = { 0x00, 0x00 };
volatile unsigned char ps2_extended[2] = { 0x00, 0x00 };
volatile unsigned char ps2_ready[2] = { 0x00, 0x00 };
volatile unsigned char ps2_check[2] = { 0x00, 0x00 };
volatile unsigned int ps2_port = 0x0000;
volatile unsigned int ps2_flags = 0x0000;

void ps2_command(unsigned char command, unsigned char port)
{
	CNCONDbits.ON = 0; // turn off interrupt-on-change
	
	unsigned char copy = command;
	
	unsigned char parity_count = 0x00;
	
	for (unsigned char i=0; i<8; i++)
	{
		if ((copy & 0x01) == 0x01) parity_count++;
		
		copy = (copy >> 1);
	}
	
	if (port == 0) // primary port
	{
		PORTDbits.RD9 = 0; // when not floating, ground them
		PORTDbits.RD10 = 0;
		TRISDbits.TRISD9 = 1; // normally they are both floating though
		TRISDbits.TRISD10 = 1; 

		DelayMS(1000); // wait a while for mouse to send it's initial code

		TRISDbits.TRISD9 = 0; // ground clock

		DelayMS(1000); // delay for at least 100 ms

		TRISDbits.TRISD10 = 0; // ground data
		TRISDbits.TRISD9 = 1; // release clock

		while (PORTDbits.RD9 == 0) { } // wait until clock is high

		while (PORTDbits.RD9 == 1) { } // wait until clock is low

		for (unsigned char i=0; i<8; i++)
		{
			if ((command & 0x01) == 0x00)
			{
				TRISDbits.TRISD10 = 0; // ground data
			}
			else
			{
				TRISDbits.TRISD10 = 1; // float data to high
			}

			command = (command >> 1);

			while (PORTDbits.RD9 == 0) { } // wait until clock is high

			while (PORTDbits.RD9 == 1) { } // wait until clock is low
		}

		if (parity_count % 2 == 1) TRISDbits.TRISD10 = 0; // ground data (for parity)
		else TRISDbits.TRISD10 = 1; // float data high (for parity)

		while (PORTDbits.RD9 == 0) { } // wait until clock is high

		while (PORTDbits.RD9 == 1) { } // wait until clock is low

		TRISDbits.TRISD10 = 1; // release data line

		while (PORTDbits.RD10 == 0) { } // wait until data is high

		while (PORTDbits.RD10 == 1) { } // wait until data is low

		while (PORTDbits.RD9 == 1) { } // wait until clock is low

		while (PORTDbits.RD10 == 0) { } // wait until data is high

		while (PORTDbits.RD9 == 0) { } // wait until clock is high
	}
	else if (port == 1) // secondary port (from splitter)
	{
		PORTDbits.RD12 = 0; // when not floating, ground them
		PORTDbits.RD13 = 0;
		TRISDbits.TRISD12 = 1; // normally they are both floating though
		TRISDbits.TRISD13 = 1; 

		DelayMS(1000); // wait a while for mouse to send it's initial code

		TRISDbits.TRISD12 = 0; // ground clock

		DelayMS(1000); // delay for at least 100 ms

		TRISDbits.TRISD13 = 0; // ground data
		TRISDbits.TRISD12 = 1; // release clock

		while (PORTDbits.RD12 == 0) { } // wait until clock is high

		while (PORTDbits.RD12 == 1) { } // wait until clock is low

		for (unsigned char i=0; i<8; i++)
		{
			if ((command & 0x01) == 0x00)
			{
				TRISDbits.TRISD13 = 0; // ground data
			}
			else
			{
				TRISDbits.TRISD13 = 1; // float data to high
			}

			command = (command >> 1);

			while (PORTDbits.RD12 == 0) { } // wait until clock is high

			while (PORTDbits.RD12 == 1) { } // wait until clock is low
		}
		
		if (parity_count % 2 == 1) TRISDbits.TRISD13 = 0; // ground data (for parity)
		else TRISDbits.TRISD13 = 1; // float data high (for parity)

		while (PORTDbits.RD12 == 0) { } // wait until clock is high

		while (PORTDbits.RD12 == 1) { } // wait until clock is low

		TRISDbits.TRISD13 = 1; // release data line

		while (PORTDbits.RD13 == 0) { } // wait until data is high

		while (PORTDbits.RD13 == 1) { } // wait until data is low

		while (PORTDbits.RD12 == 1) { } // wait until clock is low

		while (PORTDbits.RD13 == 0) { } // wait until data is high

		while (PORTDbits.RD12 == 0) { } // wait until clock is high
	}
	
	CNCONDbits.ON = 1; // turn on interrupt-on-change
	
	return;
}

volatile unsigned char ps2_conversion[256] = 
{
  	0x00,0x16,0x0C,0x0E,0x1E,0x1C,0x1D,0x15,
	0x00,0x18,0x07,0x0F,0x1F,0x09,0x60,0x00,
	0x00,0x00,0x00,0x00,0x00,0x71,0x31,0x00,
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	0x19,0x2B,0x04,0x2D,0x2A,0x01,0x00,0x00
};


#include "interrupts.c"
#include "sdcard.c" 

#include "ffconf.h"
#include "ff.h"
#include "ff.c"
#include "diskio.h"
#include "diskio.c"

#include "nvm.c"

#include "nes.c"

#include "setup.c" 



volatile char __attribute__((coherent)) list_name[100*12];
volatile unsigned short list_total = 1; // start at 1

void __attribute__((optimize("O0"))) list_generate()
{
	// Global variables
	DIR dir; // Directory information for the current directory
	FATFS fso; // File System Object for the file system we are reading from
	FILINFO fno;

	// Wait for the disk to initialise
	while(disk_initialize(0));
	// Mount the disk
	f_mount(&fso, "", 0);
	// Change dir to the root directory
	f_chdir("/");
	// Open the directory
	f_opendir(&dir, ".");
	
	unsigned int result;
	
	while (1)
	{
		for (int i=0; i<12; i++)
		{
			fno.fname[i] = 0;
			list_name[list_total*12+i] = ' ';
		}
		
		f_readdir(&dir, &fno);
		
		if (fno.fname[0] == 0) break;
		else
		{
			for (int i=0; i<12; i++)
			{
				if (fno.fname[i] > 0x20 && fno.fname[i] < 0x80)
				{
					list_name[list_total*12+i] = fno.fname[i];
				}
				else
				{
					list_name[list_total*12+i] = ' ';
					fno.fname[i] = ' ';
				}
			}
			
			result = 0;
			
			for (int i=0; i<9; i++)
			{
				if (list_name[list_total*12+i] == '.' &&
					list_name[list_total*12+i+1] == 'N' &&
					list_name[list_total*12+i+2] == 'E' &&
					list_name[list_total*12+i+3] == 'S')
				{
					result = 1;
							
					break;
				}
			}
			
			if (result == 1)
			{
				list_total++;
			}
			
			if (list_total >= 100) break;
		}
	}
	
	f_rewinddir(&dir);
}

void __attribute__((optimize("O0"))) list_display(unsigned short pos)
{
	unsigned short start = 0;
	
	if (pos >= 14) start = pos - 14;
	
	for (unsigned short i=0; i<28; i++)
	{
		if (start+i >= list_total)
		{
			display_character(0x0000, 0x0008 * i, ' ');
		
			for (unsigned short j=0; j<12; j++)
			{
				display_character(0x0008 * j + 0x0008, 0x0008 * i, ' ');
			}
			
			break;
		}
		
		display_character(0x0000, 0x0008 * i, ' ');
		
		for (unsigned short j=0; j<12; j++)
		{
			display_character(0x0008 * j + 0x0008, 0x0008 * i, list_name[(start+i)*12+j]);
		}
	}
	
	if (pos >= 14)
	{
		display_character(0x0000, 0x0008 * 14, '>');
	}
	else
	{
		display_character(0x0000, 0x0008 * pos, '>');
	}
}

void __attribute__((optimize("O0"))) list_picture(unsigned short pos)
{
	char filename[16];
	unsigned char dot = 0;
	
	for (int i=0; i<16; i++)
	{
		filename[i] = 0;
	}
	
	if (pos > 0)
	{
		for (int i=0; i<12; i++)
		{
			filename[i] = list_name[pos*12+i];

			if (filename[i] == '.')
			{
				dot = i;
				break;
			}
		}

		filename[dot+1] = 'B';
		filename[dot+2] = 'M';
		filename[dot+3] = 'P';
	}
	else
	{
		filename[0] = 'P';
		filename[1] = 'L';
		filename[2] = 'A';
		filename[3] = 'Y';
		filename[4] = 'N';
		filename[5] = 'E';
		filename[6] = 'S';
		filename[7] = '.';
		filename[8] = 'B';
		filename[9] = 'M';
		filename[10] = 'P';
	}
	
	// Global variables
	FIL file; // File handle for the file we open
	DIR dir; // Directory information for the current directory
	FATFS fso; // File System Object for the file system we are reading from
	
	//SendString("Initializing disk\n\r\\");
	
	// Wait for the disk to initialise
    while(disk_initialize(0));
    // Mount the disk
    f_mount(&fso, "", 0);
    // Change dir to the root directory
    f_chdir("/");
    // Open the directory
    f_opendir(&dir, ".");
 
	unsigned char buffer[1];
	unsigned int bytes;
	unsigned int result;
	unsigned char color;
	
	result = f_open(&file, filename, FA_READ);
	if (result == 0)
	{		
		for (unsigned int i=0; i<54; i++) // header
		{
			while (f_read(&file, &buffer[0], 1, &bytes) != 0) { } // MUST READ ONE BYTE AT A TIME!!!
		}
		
		for (unsigned int i=0; i<120; i++)
		{
			for (unsigned int j=0; j<128; j++)
			{
				color = 0x00;
				
				// blue first?
				while (f_read(&file, &buffer[0], 1, &bytes) != 0) { } // MUST READ ONE BYTE AT A TIME!!!
				
				color = (color | ((buffer[0] & 0xC0) >> 6));
				
				// green second?
				while (f_read(&file, &buffer[0], 1, &bytes) != 0) { } // MUST READ ONE BYTE AT A TIME!!!
				
				color = (color | ((buffer[0] & 0xE0) >> 3));
				
				// red third?
				while (f_read(&file, &buffer[0], 1, &bytes) != 0) { } // MUST READ ONE BYTE AT A TIME!!!
				
				color = (color | ((buffer[0] & 0xE0)));
				
				screen_buffer[(180-i)*SCREEN_X + 256 + j*2] = color;
				screen_buffer[(180-i)*SCREEN_X + 256 + j*2 + 1] = color;
			}
		}
		
		while (f_sync(&file) != 0) { }
		while (f_close(&file) != 0) { }
		
		//SendString("Read cart picture from file\n\r\\");
	}
	else
	{		
		for (unsigned int i=0; i<240; i++)
		{
			for (unsigned int j=0; j<256; j++)
			{
				screen_buffer[(240-i)*SCREEN_X + 256 + j] = 0x00;
			}
		}
		
		//SendString("Could not read cart picture from file\n\r\\");
	}	
}

int __attribute__((optimize("O0"))) main()
{
	unsigned short menu_pos = 0;
	unsigned long menu_wait = 0;
	
	unsigned long rate = 3; // default of 3:1 frame rate
	
	audio_enable = 0;
	
	Setup();
	
	DelayMS(1000);
	
	SendChar('$'); // just a 'hello world' over the UART
	
	controller_enable = 0;
	screen_frame = 0;
	
	DelayMS(1000);
	
	list_name[0] = 'P';
	list_name[1] = 'L';
	list_name[2] = 'A';
	list_name[3] = 'Y';
	list_name[4] = ' ';
	list_name[5] = 'G';
	list_name[6] = 'A';
	list_name[7] = 'M';
	list_name[8] = 'E';
	list_name[9] = ' ';
	list_name[10] = ' ';
	list_name[11] = ' ';
	
	list_generate();
	
	menu_pos = 0;
	menu_wait = 0;
	
	list_display(menu_pos);
	list_picture(menu_pos);
	
	while (PORTKbits.RK4 == 1 && PORTKbits.RK5 == 1)
	{	
		if (PORTKbits.RK0 == 0 && menu_wait == 0)
		{
			menu_wait = 0x0001FFFF;
			
			if (menu_pos > 0) menu_pos--;
			
			list_display(menu_pos);
			list_picture(menu_pos);
		}
		else
		{
			if (menu_wait > 0) menu_wait--;
		}
		
		if (PORTKbits.RK1 == 0 && menu_wait == 0)
		{
			menu_wait = 0x0001FFFF;
			
			if (menu_pos < list_total-1) menu_pos++;
			
			list_display(menu_pos);
			list_picture(menu_pos);
		}
		else
		{
			if (menu_wait > 0) menu_wait--;
		}
	}
	
	for (unsigned short i=0; i<AUDIO_LEN; i++)
	{
		audio_buffer[i] = 0x00;
	}

	for (unsigned short y=0; y<SCREEN_Y*2; y++)
	{
		for (unsigned short x=0; x<SCREEN_X; x++)
		{
			screen_buffer[y*SCREEN_X+x] = 0x00;
			screen_buffer[y*SCREEN_X+x] = 0x00;
		}
	}
	
	if (menu_pos == 0)
	{		
		audio_enable = 1; // audio on by default
		controller_enable = 1; // must be on to play games
		
		while (1)
		{ 
			if (PORTKbits.RK7 == 0)
			{
				while (PORTKbits.RK7 == 0) { }
				
				for (unsigned short i=0; i<AUDIO_LEN; i++)
				{
					audio_buffer[i] = 0x00;
				}
				
				for (unsigned short y=0; y<SCREEN_Y*2; y++)
				{
					for (unsigned short x=0; x<SCREEN_X; x++)
					{
						screen_buffer[y*SCREEN_X+x] = 0x00;
						screen_buffer[y*SCREEN_X+x] = 0x00;
					}
				}
				
				controller_enable = 0;
				screen_frame = 0;
				
				DelayMS(1000);

				display_string(0x0000, 0x0000, "  Return to Game\\");
				display_string(0x0000, 0x0008, "  Audio Enable\\");
				display_string(0x0000, 0x0010, "  Audio Disable\\");
				display_string(0x0000, 0x0018, "  Hacks Enable\\");
				display_string(0x0000, 0x0020, "  Hacks Disable\\");
				display_string(0x0000, 0x0028, "  Frames 1:1\\");
				display_string(0x0000, 0x0030, "  Frames 2:1\\");
				display_string(0x0000, 0x0038, "  Frames 3:1\\");
				display_string(0x0000, 0x0040, "  Frames 4:1\\");
				display_string(0x0000, 0x0048, "  Frames 5:1\\");
				display_string(0x0000, 0x0050, "  Load Game A\\");
				display_string(0x0000, 0x0058, "  Load Game B\\");
				display_string(0x0000, 0x0060, "  Load Game C\\");
				display_string(0x0000, 0x0068, "  Load Game D\\");
				display_string(0x0000, 0x0070, "  Save Game A\\");
				display_string(0x0000, 0x0078, "  Save Game B\\");
				display_string(0x0000, 0x0080, "  Save Game C\\");
				display_string(0x0000, 0x0088, "  Save Game D\\");
				
				DelayMS(1000);
				
				menu_pos = 0;
				menu_wait = 0;
				
				while (PORTKbits.RK4 == 1 && PORTKbits.RK5 == 1)
				{	
					display_character(0x0000, 0x0008*menu_pos, '>');

					if (PORTKbits.RK0 == 0 && menu_wait == 0)
					{
						menu_wait = 0x00013FFF;

						display_character(0x0000, 0x0008*menu_pos, ' ');

						if (menu_pos > 0) menu_pos--;
					}
					else
					{
						if (menu_wait > 0) menu_wait--;
					}

					if (PORTKbits.RK1 == 0 && menu_wait == 0)
					{
						menu_wait = 0x00013FFF;

						display_character(0x0000, 0x0008*menu_pos, ' ');

						if (menu_pos < 17) menu_pos++;
					}
					else
					{
						if (menu_wait > 0) menu_wait--;
					}
				}
				
				for (unsigned short i=0; i<AUDIO_LEN; i++)
				{
					audio_buffer[i] = 0x00;
				}

				for (unsigned short y=0; y<SCREEN_Y*2; y++)
				{
					for (unsigned short x=0; x<SCREEN_X; x++)
					{
						screen_buffer[y*SCREEN_X+x] = 0x00;
						screen_buffer[y*SCREEN_X+x] = 0x00;
					}
				}
				
				controller_enable = 1;
				
				if (menu_pos == 0) { }
				else if (menu_pos == 1) { audio_enable = 1; nes_audio_flag = 1; }
				else if (menu_pos == 2) { audio_enable = 0; nes_audio_flag = 0; }
				else if (menu_pos == 3) { nes_hack_mmc3_bottom_hud = 1; nes_hack_mmc3_sprite_priority = 1; }
				else if (menu_pos == 4) { nes_hack_mmc3_bottom_hud = 0; nes_hack_mmc3_sprite_priority = 0; }
				else if (menu_pos > 4 && menu_pos <= 9) rate = (unsigned long)(menu_pos - 4);
				else if (menu_pos == 10)
				{
					nes_load("GAME-A.SAV");
					
					nes_reset_flag = 0;
				}
				else if (menu_pos == 11)
				{
					nes_load("GAME-B.SAV");
					
					nes_reset_flag = 0;
				}
				else if (menu_pos == 12)
				{
					nes_load("GAME-C.SAV");
					
					nes_reset_flag = 0;
				}
				else if (menu_pos == 13)
				{
					nes_load("GAME-D.SAV");
					
					nes_reset_flag = 0;
				}
				else if (menu_pos == 14)
				{
					nes_save("GAME-A.SAV");
				}
				else if (menu_pos == 15)
				{
					nes_save("GAME-B.SAV");
				}
				else if (menu_pos == 16)
				{
					nes_save("GAME-C.SAV");
				}
				else if (menu_pos == 17)
				{
					nes_save("GAME-D.SAV");
				}
			}
			
			nes_loop(rate); // frame rate divider and external interrupt
		}
	}
	else
	{		
		
		char filename[16];
		
		for (int i=0; i<16; i++)
		{
			filename[i] = 0;
		}
		
		for (int i=0; i<12; i++)
		{
			filename[i] = list_name[menu_pos*12+i];
		}
		
		nes_burn(filename);
	}
	
	
	while (1)
	{
		// blink LED
		PORTDbits.RD11 = 0;
		DelayMS(100);
		DelayMS(100);
		DelayMS(100);
		DelayMS(100);
		DelayMS(100);

		PORTDbits.RD11 = 1;
		DelayMS(100);
		DelayMS(100);
		DelayMS(100);
		DelayMS(100);
		DelayMS(100);
	}
}


